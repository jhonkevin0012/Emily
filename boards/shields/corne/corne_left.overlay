/*
 * Copyright (c) 2020 Pete Johanson
 *
 * SPDX-License-Identifier: MIT
 */

#include "corne.dtsi"

/ {
    chosen {
        zephyr,display        = &oled;
        zmk,kscan             = &kscan0;
        zmk,physical-layout   = &foostan_corne_6col_layout;
    };
};

&kscan0 {
    col-gpios = <&pro_micro 21 GPIO_ACTIVE_HIGH>,
                <&pro_micro 20 GPIO_ACTIVE_HIGH>,
                <&pro_micro 19 GPIO_ACTIVE_HIGH>,
                <&pro_micro 18 GPIO_ACTIVE_HIGH>,
                <&pro_micro 15 GPIO_ACTIVE_HIGH>,
                <&pro_micro 14 GPIO_ACTIVE_HIGH>;
};

&pro_micro_i2c {
    status = "okay";
};

&oled {
    status = "okay";
    /* Usa el nodo my_name para renderizar texto fijo */
    zmk,render = <&my_name>;
};

/* Nodo que pinta tu nombre en la pantalla OLED */
my_name: print_name {
    compatible = "zmk,print-string";
    string     = "keBIMsky";
};
